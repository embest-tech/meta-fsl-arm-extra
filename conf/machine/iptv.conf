## conf/machine/iptv.conf
```bitbake
#@TYPE: Machine
#@NAME: iptv
#@SOC: i.MX6
#@DESCRIPTION: Machine configuration for i.MX6 IPTV board


include conf/machine/include/imx-base.inc
include conf/machine/include/tune-cortexa9.inc

SOC_FAMILY = "mx6:mx6q"

PREFERRED_PROVIDER_u-boot = "u-boot-iptv"
PREFERRED_PROVIDER_virtual/kernel = "linux-iptv"

UBOOT_MACHINE = "mx6qiptv_emmc_config"

KERNEL_DEVICETREE = "imx6q-iptv.dtb"

SERIAL_CONSOLE = "115200 ttymxc1"

MACHINE_FIRMWARE = "linux-firmware-iwlwifi"
```

## conf/machine/riotboard.conf
```bitbake
#@TYPE: Machine
#@NAME: riotboard
#@SOC: i.MX6
#@DESCRIPTION: Machine configuration for i.MX6 RIoTboard


include conf/machine/include/imx-base.inc
include conf/machine/include/tune-cortexa9.inc

SOC_FAMILY = "mx6:mx6s"

PREFERRED_PROVIDER_u-boot = "u-boot-riotboard"
PREFERRED_PROVIDER_virtual/kernel = "linux-riotboard"

UBOOT_MACHINE = "mx6solo_RIoTboard_config"

KERNEL_DEVICETREE = "imx6solo_RIoTboard.dtb"

SERIAL_CONSOLE = "115200 ttymxc1"

MACHINE_FIRMWARE = "linux-firmware-ralink"
```

## conf/machine/sbc9000.conf
```bitbake
#@TYPE: Machine
#@NAME: sbc9000
#@SOC: i.MX6
#@DESCRIPTION: Machine configuration for i.MX6 SBC9000


include conf/machine/include/imx-base.inc
include conf/machine/include/tune-cortexa9.inc

SOC_FAMILY = "mx6:mx6q"

PREFERRED_PROVIDER_u-boot = "u-boot-sbc9000"
PREFERRED_PROVIDER_virtual/kernel = "linux-sbc9000"

UBOOT_MACHINE = "mx6q_sbc9000_emmc_config"

KERNEL_DEVICETREE = "imx6q-sbc9000.dtb"

SERIAL_CONSOLE = "115200 ttymxc1"

MACHINE_FIRMWARE = "linux-firmware-ralink"
```
